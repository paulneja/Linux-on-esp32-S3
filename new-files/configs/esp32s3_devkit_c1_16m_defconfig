## new-files/configs/esp32s3_devkit_c1_16m_defconfig
```kconfig
BR2_xtensa=y
BR2_XTENSA_DYNCONFIG=y
BR2_TOOLCHAIN_EXTERNAL=y
BR2_TOOLCHAIN_EXTERNAL_PATH="/home/jcmvbkbc/ws/tensilica/crosstool/fdpic/builds/xtensa-esp32s3-linux-uclibcfdpic"
BR2_TOOLCHAIN_EXTERNAL_CUSTOM_PREFIX="$(ARCH)-esp32s3-linux-uclibcfdpic"
BR2_TOOLCHAIN_EXTERNAL_HEADERS_6_6=y
BR2_TOOLCHAIN_EXTERNAL_WCHAR=y
BR2_TOOLCHAIN_EXTERNAL_HAS_SSP=y
BR2_OPTIMIZE_S=y
# BR2_PIC_PIE is not set
BR2_SSP_NONE=y
BR2_RELRO_NONE=y
BR2_ROOTFS_OVERLAY="board/espressif/esp32s3/rootfs_overlay"
BR2_ROOTFS_POST_BUILD_SCRIPT="board/espressif/esp32s3/trim-libs.sh"
BR2_ROOTFS_POST_FAKEROOT_SCRIPT="board/espressif/esp32s3/mkfs-etc.sh"
BR2_ROOTFS_POST_IMAGE_SCRIPT="board/espressif/esp32s3/post-build.sh"
BR2_LINUX_KERNEL=y
BR2_LINUX_KERNEL_CUSTOM_GIT=y
BR2_LINUX_KERNEL_CUSTOM_REPO_URL="https://github.com/jcmvbkbc/linux-xtensa.git"
BR2_LINUX_KERNEL_CUSTOM_REPO_VERSION="xtensa-6.11-esp32-tag"
# SoftAP support for the esp32-ng driver (espap0 netdev + cfg80211
# start_ap/stop_ap + CMD_AP_START/STOP over the shmem IPC protocol) is not
# upstream. This directory is untracked by the kernel's own git repo, so a
# clean re-extraction silently discards local edits made directly in the
# build tree -- happened twice this session. BR2_LINUX_KERNEL_PATCH makes
# buildroot re-apply the patch after every extraction instead.
BR2_LINUX_KERNEL_PATCH="board/espressif/esp32s3/patches/linux"
BR2_LINUX_KERNEL_USE_CUSTOM_CONFIG=y
BR2_LINUX_KERNEL_CUSTOM_CONFIG_FILE="board/espressif/esp32s3/devkit_c1_16m_linux.config"
BR2_LINUX_KERNEL_IMAGE_TARGET_CUSTOM=y
BR2_LINUX_KERNEL_IMAGE_TARGET_NAME="xipImage"
BR2_LINUX_KERNEL_NEEDS_HOST_OPENSSL=y
BR2_PACKAGE_LINUX_TOOLS_GPIO=y
BR2_PACKAGE_BUSYBOX_CONFIG="board/espressif/esp32s3/busybox.config"
BR2_PACKAGE_DROPBEAR=y
BR2_PACKAGE_IW=y
BR2_PACKAGE_WIRELESS_REGDB=y
BR2_PACKAGE_WPA_SUPPLICANT=y
# hostapd needs real fork() (os_unix.c); this target's uclibc-fdpic is NOMMU
# and does not declare it, so hostapd cannot be built here. The SoftAP is
# started directly by the ESP32 firmware instead (fixed SSID, no hostapd).
BR2_PACKAGE_IPTABLES=y
# BR2_PACKAGE_URANDOM_SCRIPTS is not set
# Deliberately obvious "changeme" default (not a plausible-looking fake
# secure password) so it's unambiguous this MUST be changed via `passwd`
# before any real deployment. SSH/telnet no longer allow blank passwords.
BR2_TARGET_GENERIC_ROOT_PASSWD="changeme123"
BR2_TARGET_ROOTFS_CRAMFS=y
BR2_TARGET_ROOTFS_CRAMFS_XIP=y
BR2_TARGET_ROOTFS_JFFS2=y
BR2_TARGET_ROOTFS_JFFS2_FLASH_64=y
# BR2_TARGET_ROOTFS_TAR is not set
BR2_PACKAGE_LUA=y
BR2_PACKAGE_MBEDTLS=y
BR2_PACKAGE_LIBCURL=y
BR2_PACKAGE_LIBCURL_CURL=y
BR2_PACKAGE_LIBCURL_MBEDTLS=y
```

## sdkconfig.defaults
```kconfig
# ---- Target ----
CONFIG_IDF_TARGET="esp32s3"

# ---- Partition table ----
CONFIG_PARTITION_TABLE_CUSTOM=y
CONFIG_PARTITION_TABLE_CUSTOM_FILENAME="partitions.csv"
CONFIG_PARTITION_TABLE_FILENAME="partitions.csv"

# ---- Flash 16MB ----
CONFIG_ESPTOOLPY_FLASHSIZE_16MB=y
CONFIG_ESPTOOLPY_FLASHSIZE="16MB"
CONFIG_ESPTOOLPY_FLASHMODE_QIO=y
CONFIG_ESPTOOLPY_FLASHFREQ_80M=y

# ---- Octal PSRAM (8MB) @ 80MHz ----
CONFIG_SPIRAM=y
CONFIG_SPIRAM_MODE_OCT=y
CONFIG_SPIRAM_TYPE_AUTO=y
CONFIG_SPIRAM_SPEED_80M=y
# Keep PSRAM out of the general heap: only via heap_caps_malloc(MALLOC_CAP_SPIRAM),
# so we can grab one big contiguous block for the guest RAM.
CONFIG_SPIRAM_USE_CAPS_ALLOC=y
# Skip the boot-time PSRAM memtest to boot faster.
CONFIG_SPIRAM_MEMTEST=n

# ---- CPU 240MHz ----
CONFIG_ESP_DEFAULT_CPU_FREQ_MHZ_240=y

# ---- Emulator loop is long-running: no task watchdog ----
CONFIG_ESP_TASK_WDT_INIT=n

# ---- Bigger main-task stack (emulator runs in app_main) ----
CONFIG_ESP_MAIN_TASK_STACK_SIZE=16384
CONFIG_ESP_SYSTEM_EVENT_TASK_STACK_SIZE=4096

# ---- Console on UART0 (routed to the CH343 -> /dev/ttyACM0) ----
CONFIG_ESP_CONSOLE_UART_DEFAULT=y

# ---- lwIP: IP forwarding + NAPT (NAT for the guest's virtio-net) ----
CONFIG_LWIP_IP_FORWARD=y
CONFIG_LWIP_IPV4_NAPT=y
```
